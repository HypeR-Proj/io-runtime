## Kconfig
```kconfig
# SPDX-FileCopyrightText: 2026 roolrz
# SPDX-License-Identifier: Apache-2.0

config SYSTEM_APP_IO_RUNTIME_SYSTEM
    bool "io-runtime-system (/svc/io-runtime)"
    default y
    depends on SYSTEM_APP_COMPONENT_MANAGER
    help
        Build and deploy hyper-io-runtime-system at /svc/io-runtime.
```
